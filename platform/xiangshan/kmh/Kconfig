## platform/xiangshan/kmh/Kconfig
```kconfig
# SPDX-License-Identifier: BSD-2-Clause

config PLATFORM_KMH
	bool
	select FDT
	select IPI_MSWI
	select SERIAL_UART8250
	select TIMER_MTIMER
	default y
```
